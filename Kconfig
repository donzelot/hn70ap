## Kconfig
```kconfig
#
# For a description of the syntax of this configuration file,
# see the file kconfig-language.txt in the NuttX tools repository.
#

if ARCH_BOARD_CUSTOM

comment "----- hn70ap board features -----"

config ARCH_HAVE_LEDS
	bool
	default y

config HN70AP_HWDEBUG_BLINK
	bool "Just Blink leds instead of starting NuttX"

config HN70AP_SCREEN
	bool "Enable OLED screen (requires I2C3)"

config HN70AP_ETHERNET
	bool "Enable Ethernet (requires ETHMAC)"
	select ARCH_PHY_INTERRUPT if NETDEVICES

if HN70AP_ETHERNET

config HN70AP_ETHERNET_EEMAC
	bool "Load MAC address from 24AA02E48 EEPROM"
	depends on HN70AP_EEPROM

endif

config HN70AP_RADIO
	bool

config HN70AP_MAINRADIO
	bool "Enable main radio (requires SPI4)"
	select HN70AP_RADIO

if HN70AP_MAINRADIO

config HN70AP_MAINRADIO_TCXO
	bool "Clock provided by TCXO / External clock"

endif

config HN70AP_AUXRADIO
	bool "Enable aux radio (requires SPI4)"
	select HN70AP_RADIO

if HN70AP_AUXRADIO

config HN70AP_AUXRADIO_HIGHPOWER
	bool "Board has a high-power RF4463 module instead of a RFM26"

endif

endif # ARCH_BOARD_HN70AP
```

## apps/beacon/Kconfig
```kconfig
#
# For a description of the syntax of this configuration file,
# see the file kconfig-language.beacon in the NuttX tools repository.
#

config HN70AP_BEACON
	bool "RF beacon"
	default n
	---help---
		Radio beacon regularly transmitting packets on RF.

if HN70AP_BEACON

config HN70AP_BEACON_PROGNAME
	string "Program name"
	default "beacon"
	depends on BUILD_KERNEL
	---help---
		This is the name of the program that will be use when the NSH ELF
		program is installed.

config HN70AP_BEACON_PRIORITY
	int "beacon task priority"
	default 100

config HN70AP_BEACON_STACKSIZE
	int "beacon stack size"
	default 2048

endif
```

## apps/config/Kconfig
```kconfig
#
# For a description of the syntax of this configuration file,
# see the file kconfig-language.txt in the NuttX tools repository.
#

config HN70AP_CONFIG
	bool "system configuration app"
	default n
	---help---
		The config app manages the system settings.

if HN70AP_CONFIG

config HN70AP_CONFIG_PROGNAME
	string "Program name"
	default "config"
	depends on BUILD_KERNEL
	---help---
		This is the name of the program that will be use when the NSH ELF
		program is installed.

config HN70AP_CONFIG_PRIORITY
	int "config task priority"
	default 100

config HN70AP_CONFIG_STACKSIZE
	int "config stack size"
	default 2048

endif
```

## apps/libhn70ap/Kconfig
```kconfig
#
# For a description of the syntax of this configuration file,
# see the file kconfig-language.txt in the NuttX tools repository.
#

config LIBHN70AP
	bool "hn70ap common Library"
	default y
```

## apps/rxt/Kconfig
```kconfig
#
# For a description of the syntax of this configuration file,
# see the file kconfig-language.txt in the NuttX tools repository.
#

config HN70AP_RXT
	bool "hn70ap RX test"
	default y
	---help---
		Test Radio Reception.

if HN70AP_RXT

config HN70AP_RXT_PROGNAME
	string "Program name"
	default "rxt"
	depends on BUILD_KERNEL
	---help---
		This is the name of the program that will be use when the NSH ELF
		program is installed.

config HN70AP_RXT_PRIORITY
	int "hn70ap rxt task priority"
	default 100

config HN70AP_RXT_STACKSIZE
	int "hn70ap rxt stack size"
	default 2048

endif
```

## apps/status/Kconfig
```kconfig
#
# For a description of the syntax of this configuration file,
# see the file kconfig-language.txt in the NuttX tools repository.
#

config HN70AP_STATUS
	bool "\"Hello, World!\" example for hn70ap"
	default n
	---help---
		Enable the \"Hello, World!\" example for hn70ap

if HN70AP_STATUS

config HN70AP_STATUS_PROGNAME
	string "Program name"
	default "status"
	depends on BUILD_KERNEL
	---help---
		This is the name of the program that will be use when the NSH ELF
		program is installed.

config HN70AP_STATUS_PRIORITY
	int "Hello hn70ap task priority"
	default 100

config HN70AP_STATUS_STACKSIZE
	int "Hello hn70ap stack size"
	default 2048

endif
```

## apps/sysdaemon/Kconfig
```kconfig
#
# For a description of the syntax of this configuration file,
# see the file kconfig-language.txt in the NuttX tools repository.
#

config HN70AP_SYSDAEMON
	bool "system daemon"
	default y
	---help---
		The system daemon manages the ethernet link status, the oled screen, then starts nsh.

if HN70AP_SYSDAEMON

config HN70AP_SYSDAEMON_PROGNAME
	string "Program name"
	default "sysdaemon"
	depends on BUILD_KERNEL
	---help---
		This is the name of the program that will be use when the NSH ELF
		program is installed.

config HN70AP_SYSDAEMON_PRIORITY
	int "sysdaemon task priority"
	default 100

config HN70AP_SYSDAEMON_STACKSIZE
	int "sysdaemon stack size"
	default 2048

endif
```

## apps/txt/Kconfig
```kconfig
#
# For a description of the syntax of this configuration file,
# see the file kconfig-language.txt in the NuttX tools repository.
#

config HN70AP_TXT
	bool "TX test"
	default y
	---help---
		Test Radio Transmission.

if HN70AP_TXT

config HN70AP_TXT_PROGNAME
	string "Program name"
	default "txt"
	depends on BUILD_KERNEL
	---help---
		This is the name of the program that will be use when the NSH ELF
		program is installed.

config HN70AP_TXT_PRIORITY
	int "txt task priority"
	default 100

config HN70AP_TXT_STACKSIZE
	int "txt stack size"
	default 2048

endif
```

## apps/update/Kconfig
```kconfig
#
# For a description of the syntax of this configuration file,
# see the file kconfig-language.txt in the NuttX tools repository.
#

config HN70AP_UPDATE
	bool "Update tool"
	default n
	---help---
		This tool can be used to update the on board firmware.

if HN70AP_UPDATE

config HN70AP_UPDATE_PROGNAME
	string "Program name"
	default "status"
	depends on BUILD_KERNEL
	---help---
		This is the name of the program that will be use when the NSH ELF
		program is installed.

config HN70AP_UPDATE_PRIORITY
	int "update tool task priority"
	default 100

config HN70AP_UPDATE_STACKSIZE
	int "update tool stack size"
	default 2048

endif
```
